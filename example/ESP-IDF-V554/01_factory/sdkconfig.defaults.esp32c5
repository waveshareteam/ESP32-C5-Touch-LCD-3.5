## example/ESP-IDF-V554/01_factory/sdkconfig.defaults.esp32c5
```kconfig
CONFIG_BLINK_GPIO=27
CONFIG_BLINK_LED_STRIP=y
CONFIG_ESP_WIFI_STATIC_RX_BUFFER_NUM=6
CONFIG_ESP_WIFI_DYNAMIC_RX_BUFFER_NUM=16
CONFIG_ESP_WIFI_DYNAMIC_TX_BUFFER_NUM=16
CONFIG_ESP_WIFI_RX_MGMT_BUF_NUM_DEF=3
CONFIG_ESP_WIFI_MGMT_SBUF_NUM=16
```

## example/ESP-IDF-V554/02_lvgl_demo/sdkconfig.defaults
```kconfig
# ESP32-C5-Touch-LCD-3.5: Flash settings and LVGL benchmark defaults.
CONFIG_IDF_TARGET="esp32c5"
CONFIG_ESPTOOLPY_FLASHMODE_DIO=y
CONFIG_ESPTOOLPY_FLASHFREQ_80M=y
CONFIG_ESPTOOLPY_FLASHSIZE_32MB=y
CONFIG_PARTITION_TABLE_OFFSET=0x8000
CONFIG_COMPILER_OPTIMIZATION_SIZE=y
CONFIG_PARTITION_TABLE_CUSTOM=y
CONFIG_PARTITION_TABLE_CUSTOM_FILENAME="partitions.csv"
CONFIG_FREERTOS_HZ=1000
CONFIG_FREERTOS_TASK_CREATE_ALLOW_EXT_MEM=y

CONFIG_LV_COLOR_DEPTH_16=y
CONFIG_LV_USE_CLIB_MALLOC=y
CONFIG_LV_USE_CLIB_STRING=y
CONFIG_LV_USE_CLIB_SPRINTF=y
CONFIG_LV_OS_FREERTOS=y
CONFIG_LV_USE_FREERTOS_TASK_NOTIFY=y
CONFIG_LV_DRAW_THREAD_STACK_SIZE=8192
CONFIG_LV_DRAW_THREAD_PRIO=3
CONFIG_LV_DEF_REFR_PERIOD=30
CONFIG_LV_OBJ_STYLE_CACHE=y
CONFIG_LV_BUILD_EXAMPLES=y
CONFIG_LV_BUILD_DEMOS=y
CONFIG_LV_USE_DEMO_WIDGETS=y
CONFIG_LV_USE_DEMO_BENCHMARK=y

CONFIG_BSP_I2C_NUM=0
CONFIG_BSP_I2C_FAST_MODE=y
CONFIG_BSP_LCD_TRANS_QUEUE_DEPTH=2
CONFIG_BSP_I2S_NUM=0
```

## example/ESP-IDF-V554/06_shtc3/sdkconfig.defaults
```kconfig
# ESP32-C5-Touch-LCD-3.5: Flash and partition settings.
CONFIG_IDF_TARGET="esp32c5"
CONFIG_ESPTOOLPY_FLASHMODE_DIO=y
CONFIG_ESPTOOLPY_FLASHFREQ_80M=y
CONFIG_ESPTOOLPY_FLASHSIZE_32MB=y
CONFIG_PARTITION_TABLE_CUSTOM=y
CONFIG_PARTITION_TABLE_CUSTOM_FILENAME="partitions.csv"
CONFIG_PARTITION_TABLE_OFFSET=0x8000

# Board PSRAM and CPU settings.
CONFIG_ESP_DEFAULT_CPU_FREQ_MHZ_240=y
CONFIG_SPIRAM=y
CONFIG_SPIRAM_MODE_QUAD=y
CONFIG_SPIRAM_SPEED_80M=y
CONFIG_SPIRAM_BOOT_HW_INIT=y
CONFIG_SPIRAM_BOOT_INIT=y
CONFIG_SPIRAM_USE_MALLOC=y
CONFIG_SPIRAM_MEMTEST=y
CONFIG_SPIRAM_MALLOC_ALWAYSINTERNAL=16384
CONFIG_SPIRAM_MALLOC_RESERVE_INTERNAL=32768

CONFIG_BSP_I2C_NUM=0
CONFIG_BSP_I2C_FAST_MODE=y
CONFIG_BSP_I2S_NUM=0
```

## example/ESP-IDF-V554/08_AXP2101/sdkconfig.defaults
```kconfig
CONFIG_IDF_TARGET="esp32c5"
CONFIG_ESPTOOLPY_FLASHMODE_DIO=y
CONFIG_ESPTOOLPY_FLASHFREQ_80M=y
CONFIG_ESPTOOLPY_FLASHSIZE_32MB=y
CONFIG_PARTITION_TABLE_CUSTOM=y
CONFIG_PARTITION_TABLE_CUSTOM_FILENAME="partitions.csv"
CONFIG_PARTITION_TABLE_OFFSET=0x8000
CONFIG_I2C_MASTER_PORT_NUM=0
CONFIG_I2C_MASTER_FREQUENCY=400000
CONFIG_PMU_I2C_SCL=26
CONFIG_PMU_I2C_SDA=27
CONFIG_PMU_INTERRUPT_PIN=-1
```

## examples/factory/components/esp32_c5_touch_lcd_3_5/Kconfig
```kconfig
menu "ESP32-C5 Touch LCD 3.5 BSP"
    config BSP_LCD_POWERON_RESTART
        bool "Preserve original LCD cold-start software restart"
        default n
        help
            Restart once after creating LCD SPI IO on a power-on reset,
            as in the original 260911 factory firmware.
    config BSP_LCD_SPI_CLOCK_HZ
        int "LCD SPI clock (Hz)"
        range 10000000 80000000
        default 60000000
    config BSP_LCD_BUFFER_HEIGHT
        int "LVGL draw buffer height (PSRAM)"
        range 10 80
        default 80
    config BSP_LCD_BRIGHTNESS
        int "Initial backlight percentage"
        range 0 100
        default 80
endmenu
```
